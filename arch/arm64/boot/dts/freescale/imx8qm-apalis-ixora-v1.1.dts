// SPDX-License-Identifier: GPL-2.0+ OR X11
/*
 * Copyright 2019 Toradex
 */

/dts-v1/;

#include "imx8qm-apalis.dtsi"
#include "imx8qm-apalis-ixora-v1.1.dtsi"

/ {
	model = "Toradex Apalis iMX8QM/QP on Apalis Ixora V1.1 Carrier Board";
	compatible = "toradex,apalis-imx8qm-ixora-v1.1", "toradex,apalis-imx8qm-ixora",
		     "toradex,apalis-imx8qm", "fsl,imx8qm";
};
